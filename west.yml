## west.yml
```yaml
manifest:
  projects:
  - name: QueuePtr
    url: ssh://git@github.com/cdesjardins/QueuePtr
    revision: 93a4788cbf1cc2938dd7292eeeba4988fccbf0bc
  - name: build
    url: ssh://git@github.com/cdesjardins/build
    revision: 75876170a747f316b92c111033cb7a4656a13cf3
    west-commands: west-commands.yml
  - name: cppssh
    url: ssh://git@github.com/cdesjardins/cppssh
    revision: 9e8b61826d5e340ef4071998c64c9fab43149df1
  - name: include
    url: ssh://git@github.com/cdesjardins/include
    revision: dcd4b17bebe9b93b16c8ab86291d8b829b7efcf5
  - name: CDLogger
    url: ssh://git@github.com/cdesjardins/CDLogger
    revision: 46717329cd18bf1c1b7a0f123f53ddb7afe5e8c5
  - name: botan
    url: ssh://git@github.com/cdesjardins/botan
    revision: 45d6f286c320b2f2efd5373d195ec88c367e3071
    path: external/botan
    clone-depth: 1
  self:
    path: ComBomb
```
